## app/boards/stm32g031k8/Kconfig.defconfig
```kconfig
if BOARD_STM32G031K8

config SPI_STM32_INTERRUPT
	default y
	depends on SPI

endif
```

## app/drivers/led_sensor/Kconfig
```kconfig
menuconfig LED_SENSOR
    bool "Led Sensor"
    default y
    depends on DT_HAS_CUSTOM_LED_SENSOR_ENABLED
    select GPIO
    help
      Enable the LED Sensor

if LED_SENSOR
config LED_SENSOR_INIT_PRIORITY
	int "Init-Priorität"
	default 90
endif
```

## boards/st/stm32g031k8/board.yml
```yaml
board:
  name: stm32g031k8
  full_name: Nucleo G031K8
  vendor: st
  socs:
    - name: stm32g031xx
```
